## firmware/esp32/esp_idf/sdkconfig.defaults
```kconfig
CONFIG_IDF_TARGET="esp32s3"

# CPU Frequency: 240 MHz
CONFIG_ESP_DEFAULT_CPU_FREQ_MHZ_240=y
CONFIG_ESP_DEFAULT_CPU_FREQ_MHZ=240

# PSRAM / External RAM
CONFIG_SPIRAM=y
CONFIG_SPIRAM_MODE_OCT=y
CONFIG_SPIRAM_SPEED_80M=y

# Flash Size and Custom Partitions
CONFIG_ESPTOOLPY_FLASHSIZE_8MB=y
CONFIG_PARTITION_TABLE_CUSTOM=y
CONFIG_PARTITION_TABLE_CUSTOM_FILENAME="partitions.csv"

# Performance Optimization (-O3)
CONFIG_COMPILER_OPTIMIZATION_PERF=y

# FreeRTOS Main Task Stack
CONFIG_ESP_MAIN_TASK_STACK_SIZE=32768
```
